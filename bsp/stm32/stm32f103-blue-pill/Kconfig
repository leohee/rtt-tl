## bsp/stm32/stm32f103-blue-pill/Kconfig
```kconfig
mainmenu "RT-Thread Configuration"

config BSP_DIR
    string
    option env="BSP_ROOT"
    default "."

config RTT_DIR
    string
    option env="RTT_ROOT"
    default "../../.."

source "$RTT_DIR/Kconfig"
source "../libraries/Kconfig"
source "board/Kconfig"
```

## libcpu/Kconfig
```kconfig
if ARCH_ARMV8 && ARCH_CPU_64BIT
    menu "AArch64 Architecture Configuration"
    config ARCH_TEXT_OFFSET
        hex "Text offset"
        default 0x200000
    config ARCH_RAM_OFFSET
        hex "RAM offset"
        default 0
    config ARCH_SECONDARY_CPU_STACK_SIZE
        int "Secondary CPU stack size"
        default 4096
    config ARCH_HAVE_EFFICIENT_UNALIGNED_ACCESS
        bool
        default y
    endmenu
endif

config ARCH_CPU_64BIT
    bool

config RT_USING_CACHE
    bool
    default n

config RT_USING_HW_ATOMIC
    bool
    default n

config ARCH_CPU_BIG_ENDIAN
    bool

config ARCH_ARM_BOOTWITH_FLUSH_CACHE
    bool
    default n

config ARCH_CPU_STACK_GROWS_UPWARD
    bool
    default n

config RT_USING_CPU_FFS
    bool
    default n

config ARCH_MM_MMU
    bool

config ARCH_MM_MPU
    bool

config ARCH_ARM
    bool

config ARCH_ARM_CORTEX_M
    bool
    select ARCH_ARM

config ARCH_ARM_CORTEX_FPU
    bool

config ARCH_ARM_CORTEX_SECURE
    bool


config ARCH_ARM_CORTEX_M3
    bool
    select ARCH_ARM_CORTEX_M
    select RT_USING_CPU_FFS
    select RT_USING_HW_ATOMIC


config ARCH_ARM_MMU
    bool
    select RT_USING_CACHE
    select ARCH_MM_MMU
    depends on ARCH_ARM



config ARCH_CPU_STACK_GROWS_UPWARD
    bool
    default n
```
